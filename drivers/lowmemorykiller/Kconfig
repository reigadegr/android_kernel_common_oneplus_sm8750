## drivers/lowmemorykiller/Kconfig
```kconfig
menu "XRING LMK"

config XRING_LMK
        tristate "XRING LMK MODULE"
        default y
        help
          Choose this option to enable xring lowmemorykiller.
          When the system enters a low memory scenario or user mode
          actively triggers recycling, this module will be called to
          kill the process.

config XRING_LMK_MULIT_KILL
        bool "XRING LMK MULIT KILL ENABLE"
        depends on XRING_LMK
        help
          Choose this option to enable xring lowmemorykiller mulit killer.
          After turning on this function, each killing process will be checked
          and killed according to the multi-kill configuration issued by the user.
          The relevant configurations include the number of killing processes, timeout delay, etc.

endmenu
```

## drivers/soc/fpga_notify/Kconfig
```kconfig
config OPLUS_FPGA_NOTIFY
    tristate "fpga noity"
    default y
    help
      Say Y here if you have fpga notify build into driver.
      Say M here if you have fpga notify as module.
```

## kernel/sched/Kconfig
```kconfig
# SPDX-License-Identifier: GPL-2.0-only
source "kernel/sched/walt/Kconfig"
source "kernel/sched/cpufreq_bouncing/Kconfig"
```

## mm/mm_osvelte/Kconfig
```kconfig
config OPLUS_FEATURE_MM_OSVELTE
	tristate "osvelte driver"
	default y
	help
	  This driver used for memory debugging.
```
